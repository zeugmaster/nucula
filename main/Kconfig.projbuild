## main/Kconfig.projbuild
```kconfig
menu "Nucula"

    config NUCULA_SELFTEST_ON_BOOT
        bool "Run crypto/keyset self-tests at every boot"
        default n
        help
            Runs the BDHKE/DLEQ/NUT-13 crypto vectors and the keyset-id
            derivation self-tests during app_main. Costs roughly a second
            of boot time; the same tests are always available at runtime
            via the 'selftest' console command.

endmenu
```

## sdkconfig.defaults
```kconfig
CONFIG_ESP_MAIN_TASK_STACK_SIZE=16384
CONFIG_PARTITION_TABLE_CUSTOM=y
CONFIG_PARTITION_TABLE_CUSTOM_FILENAME="partitions.csv"
CONFIG_ESPTOOLPY_FLASHSIZE_4MB=y

# Size optimization: -Os instead of -Og saves ~100-150KB
CONFIG_COMPILER_OPTIMIZATION_SIZE=y

# We only need STA mode, disable SoftAP (~30KB)
CONFIG_ESP_WIFI_SOFTAP_SUPPORT=n

# Disable IPv6 since mints are IPv4 (~20KB)
CONFIG_LWIP_IPV6=n

# Reduce max sockets (default 10 is overkill)
CONFIG_LWIP_MAX_SOCKETS=4

# I2C master ISR in IRAM for reliable NFC communication
CONFIG_I2C_MASTER_ISR_HANDLER_IN_IRAM=y

# Task telemetry for the console 'tasks' command (stack high-water marks)
CONFIG_FREERTOS_USE_TRACE_FACILITY=y

# 1 kHz tick: vTaskDelay(pdMS_TO_TICKS(1)) really is 1 ms, not a 10 ms
# tick. Matters for keypad scans holding the shared I2C bus and NCI
# pacing. Tick ISR cost at 1 kHz is ~0.3% CPU.
CONFIG_FREERTOS_HZ=1000

# Quiet production logging: default WARN at runtime, but INFO strings stay
# compiled in so the console 'log i <tag>' command can re-enable them.
CONFIG_LOG_DEFAULT_LEVEL_WARN=y
CONFIG_LOG_MAXIMUM_LEVEL_INFO=y

# Memory-constrained TLS. By default each HTTPS connection allocates two
# ~16 KB mbedTLS content buffers up front, which must each be contiguous.
# Once the heap is fragmented by cached mint keysets the swap-POST handshake
# can no longer get them and fails with "PK verify failed / signature
# verification failed". Dynamic buffers size the RX buffer to the actual TLS
# record and free the CA bundle + SSL config after the handshake, cutting the
# peak contiguous demand dramatically.
CONFIG_MBEDTLS_DYNAMIC_BUFFER=y
CONFIG_MBEDTLS_DYNAMIC_FREE_CA_CERT=y
CONFIG_MBEDTLS_DYNAMIC_FREE_CONFIG_DATA=y
```
